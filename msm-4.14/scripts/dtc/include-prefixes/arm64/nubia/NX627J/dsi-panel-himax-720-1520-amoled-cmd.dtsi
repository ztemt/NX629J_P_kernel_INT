/* Copyright (c) 2016-2017, The Linux Foundation. All rights reserved.
 *
 * This program is free software; you can redistribute it and/or modify
 * it under the terms of the GNU General Public License version 2 and
 * only version 2 as published by the Free Software Foundation.
 *
 * This program is distributed in the hope that it will be useful,
 * but WITHOUT ANY WARRANTY; without even the implied warranty of
 * MERCHANTABILITY or FITNESS FOR A PARTICULAR PURPOSE.  See the
 * GNU General Public License for more details.
 */

&mdss_mdp {
	dsi_himax_720_1520_cmd: qcom,mdss_dsi_himax_720_1520_amoled_cmd {
		qcom,mdss-dsi-panel-name = "dsi himax 720 1520 amoled cmd panel";
		qcom,mdss-dsi-panel-type = "dsi_cmd_mode";
		qcom,mdss-dsi-virtual-channel-id = <0>;
		qcom,mdss-dsi-stream = <0>;
		qcom,mdss-dsi-bpp = <24>;
		qcom,mdss-dsi-color-order = "rgb_swap_rgb";
		qcom,mdss-dsi-underflow-color = <0xff>;
		qcom,mdss-dsi-border-color = <0>;
		qcom,mdss-dsi-panel-blackness-level = <3230>;
		qcom,mdss-dsi-traffic-mode = "non_burst_sync_event";
		qcom,mdss-dsi-bllp-eof-power-mode;
		qcom,mdss-dsi-bllp-power-mode;
		qcom,mdss-dsi-lane-0-state;
		qcom,mdss-dsi-lane-1-state;
		qcom,mdss-dsi-lane-2-state;
		qcom,mdss-dsi-lane-3-state;
		qcom,mdss-dsi-dma-trigger = "trigger_sw";
		qcom,mdss-dsi-mdp-trigger = "none";
		qcom,mdss-dsi-reset-sequence =<1 2>, <0 2>, <1 60>;
		qcom,mdss-dsi-sec-bl-pmic-control-type = "bl_ctrl_dcs";
		qcom,mdss-dsi-bl-min-level = <1>;
		qcom,mdss-dsi-bl-max-level = <4095>;
		qcom,mdss-brightness-max-level = <4095>;
		qcom,adjust-timer-wakeup-ms = <1>;
		qcom,mdss-dsi-te-pin-select = <1>;
		qcom,mdss-dsi-wr-mem-start = <0x2c>;
		qcom,mdss-dsi-wr-mem-continue = <0x3c>;
		qcom,mdss-dsi-mode-sel-gpio-state = "single_port";
		//qcom,panel-supply-entries = <&dsi_panel_pwr_supply>;
		qcom,panel-sec-supply-entries = <&dsi_panel_pwr_supply>;

		qcom,panel-sec-mode-gpio = <&tlmm 60 0>;
		qcom,platform-te-gpio = <&tlmm 9 0>;
		qcom,platform-sec-reset-gpio = <&tlmm 57 0>;
		qcom,back-panel-vci-3p3-gpio = <&tlmm 87 0>;
		qcom,ts-1p8-vddi-gpio = <&tlmm 90 0>;

		qcom,mdss-dsi-te-dcs-command = <1>;
		qcom,mdss-dsi-te-check-enable;
		qcom,mdss-dsi-te-using-te-pin;
		qcom,mdss-dsi-t-clk-post = <0x12>;
		qcom,mdss-dsi-t-clk-pre = <0x28>;


/****************************************ESD CHECK START***********************************/
		/*qcom,esd-check-enabled;
		qcom,mdss-dsi-panel-status-command = [06 01 00 01 05 00 01 0a];
		qcom,mdss-dsi-panel-status-command-state = "dsi_lp_mode";
		qcom,mdss-dsi-panel-status-check-mode = "reg_read";
		qcom,mdss-dsi-panel-status-read-length = <1>;
		qcom,mdss-dsi-panel-max-error-count = <1>;
		qcom,mdss-dsi-panel-status-value = <0x1c>;*/
/*****************************************ESD CHECK END*************************************/

		qcom,mdss-dsi-display-timings {
			timing@0{
				qcom,mdss-dsi-panel-framerate = <60>;
				qcom,mdss-dsi-panel-width = <720>;
				qcom,mdss-dsi-panel-height = <1520>;
				qcom,mdss-dsi-h-front-porch = <26>;
				qcom,mdss-dsi-h-back-porch = <41>;
				qcom,mdss-dsi-h-pulse-width = <2>;
				qcom,mdss-dsi-h-sync-skew = <0>;
				qcom,mdss-dsi-h-sync-pulse = <0>;
				qcom,mdss-dsi-v-back-porch = <8>;
				qcom,mdss-dsi-v-front-porch = <16>;
				qcom,mdss-dsi-v-pulse-width = <17>;

				qcom,mdss-dsi-h-left-border = <0>;
				qcom,mdss-dsi-h-right-border = <0>;
				qcom,mdss-dsi-v-top-border = <0>;
				qcom,mdss-dsi-v-bottom-border = <0>;
				qcom,mdss-dsi-panel-phy-timings = [00 11 04 04 1E 1E 04 04 02 02 04 10 14 00];
				qcom,display-topology = <1 0 1>;
				qcom,default-topology-index = <0>;

				qcom,mdss-dsi-on-command = [
					39 01 00 00 00 00 02 FE 70
					39 01 00 00 00 00 02 A9 3D
					39 01 00 00 00 00 02 FE 00
					39 01 00 00 00 00 02 C2 08
					39 01 00 00 00 00 02 35 00
					39 01 00 00 00 00 02 51 FF
					29 01 00 00 32 00 02 11 00
					29 01 00 00 32 00 02 29 00];

				qcom,mdss-dsi-off-command = [
					05 01 00 00 28 00 01 28
					05 01 00 00 78 00 01 10];
				qcom,mdss-dsi-on-command-state = "dsi_lp_mode";
				qcom,mdss-dsi-off-command-state = "dsi_hs_mode";
				qcom,mdss-dsi-lp11-init;
				qcom,mdss-dsi-init-delay-us=<30000>;

/***************************************AOD start***************************************************/
				nuiba,mdss-dsi-sub-lcd-command-aod-on = [15 00 00 00 00 00 02 fe 40
				                                         15 00 00 00 00 00 02 38 68
				                                         15 01 00 00 00 00 02 fe 00
														 05 01 00 00 00 00 01 39];
				nuiba,mdss-dsi-sub-lcd-command-aod-off = [15 00 00 00 00 00 02 fe 40
				                                          15 00 00 00 00 00 02 38 60
				                                          15 01 00 00 00 00 02 fe 00
														  05 01 00 00 00 00 01 38];
				nuiba,mdss-dsi-sub-lcd-command-aod-on-state = "dsi_lp_mode";
				nuiba,mdss-dsi-sub-lcd-command-aod-off-state = "dsi_lp_mode";
/***************************************AOD end***************************************************/
			};
		};
	};
};
